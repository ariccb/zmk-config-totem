## config/Kconfig
```kconfig
menu "Adaptive Key Options"

config ZMK_ADAPTIVE_KEY_MAX_TRIGGER_CONDITIONS
    int "Maximum number of adaptive key triggers"
    default 32

config ZMK_ADAPTIVE_KEY_MAX_BINDINGS
    int "Maximum number of trigger bindings"
    default 4

config ZMK_ADAPTIVE_KEY_WAIT_MS
    int "Time to wait between key presses when binding multiple behaviors"
    default 5

config ZMK_ADAPTIVE_KEY_TAP_MS
    int "Time to hold key presses when binding multiple behaviors"
    default 5

#Adaptive key options
endmenu

DT_COMPAT_ZMK_BEHAVIOR_ADAPTIVE_KEY := zmk,behavior-adaptive-key

config ZMK_BEHAVIOR_ADAPTIVE_KEY
    bool
    default $(dt_compat_enabled,$(DT_COMPAT_ZMK_BEHAVIOR_ADAPTIVE_KEY))

DT_COMPAT_ZMK_BEHAVIOR_OS_MODE := zmk,behavior-os-mode

config ZMK_BEHAVIOR_OS_MODE
    bool
    default $(dt_compat_enabled,$(DT_COMPAT_ZMK_BEHAVIOR_OS_MODE))

DT_COMPAT_ZMK_BEHAVIOR_AUTOCORRECT := zmk,behavior-autocorrect

config ZMK_BEHAVIOR_AUTOCORRECT
    bool
    default $(dt_compat_enabled,$(DT_COMPAT_ZMK_BEHAVIOR_AUTOCORRECT))

DT_COMPAT_ZMK_BEHAVIOR_QUOPOSTROKEY := zmk,behavior-quopostrokey

config ZMK_BEHAVIOR_QUOPOSTROKEY
    bool
    default $(dt_compat_enabled,$(DT_COMPAT_ZMK_BEHAVIOR_QUOPOSTROKEY))

DT_COMPAT_ZMK_BEHAVIOR_EXP_BSPC := zmk,behavior-exp-bspc

config ZMK_BEHAVIOR_EXP_BSPC
    bool
    default $(dt_compat_enabled,$(DT_COMPAT_ZMK_BEHAVIOR_EXP_BSPC))

DT_COMPAT_ZMK_BEHAVIOR_NAV_LOCK := zmk,behavior-nav-lock

config ZMK_BEHAVIOR_NAV_LOCK
    bool
    default $(dt_compat_enabled,$(DT_COMPAT_ZMK_BEHAVIOR_NAV_LOCK))

config TOTEM_OS_MODE_DEFAULT_WINDOWS
    bool "Boot into Windows shortcut mode before a Mac or Windows key is saved"
    depends on ZMK_BEHAVIOR_OS_MODE
    default n
    help
      When unset, a fresh board boots in Mac mode. config/totem.conf sets
      this so a fresh Totem boots in Windows mode. Pressing the Mac or
      Windows key on the System layer stores the choice. That saved choice
      is used on later boots and overrides this setting.
```

## config/dts/bindings/behaviors/zmk,behavior-autocorrect.yaml
```yaml
# SPDX-License-Identifier: MIT

description: |
  Toggle the Totem autocorrect trie. Autocorrect is on until this key
  stores the other choice. The saved value is totem/ac/en.

compatible: "zmk,behavior-autocorrect"

include: zero_param.yaml
```

## config/dts/bindings/behaviors/zmk,behavior-exp-bspc.yaml
```yaml
# SPDX-License-Identifier: MIT

description: |
  Backspace that repeats on an accelerating curve. The first delete is
  immediate. Later deletes follow Getreuer's REP_DELAY_MS delays.
  Release cancels the repeat.

compatible: "zmk,behavior-exp-bspc"

include: zero_param.yaml
```

## config/dts/bindings/behaviors/zmk,behavior-nav-lock.yaml
```yaml
# SPDX-License-Identifier: MIT

description: |
  Toggle a layer and remember it as latched. The status LED slow-blinks
  while that layer stays on. A momentary hold of the same layer does not.

compatible: "zmk,behavior-nav-lock"

include: one_param.yaml
```

## config/dts/bindings/behaviors/zmk,behavior-os-mode.yaml
```yaml
# SPDX-License-Identifier: MIT

description: |
  Mac/Windows shortcut mode, and the shortcuts that pick a finished chord
  per OS (redo, clipboard history, browser back and forward,
  current-app windows, the app switcher, Command+Alt,
  previous/next tab, select word, select line, and Cmd/Ctrl+Enter).

compatible: "zmk,behavior-os-mode"

include: zero_param.yaml

properties:
  command:
    type: string
    required: true
    enum:
      - "mac"
      - "win"
      - "redo"
      - "clip"
      - "fwd"
      - "back"
      - "fwd_br"
      - "apps"
      - "switch"
      - "galt"
      - "tab_prev"
      - "tab_next"
      - "selword"
      - "selline"
      - "enter"
```

## config/dts/bindings/behaviors/zmk,behavior-quopostrokey.yaml
```yaml
# SPDX-License-Identifier: MIT

description: |
  Getreuer Quopostrokey. After a letter, tap apostrophe. Otherwise type
  a pair of double quotes and move the cursor between them.

compatible: "zmk,behavior-quopostrokey"

include: zero_param.yaml
```
